## Config.in
```kconfig
source "$BR2_EXTERNAL_edgemap_PATH/package/libnitrokey/Config.in"
source "$BR2_EXTERNAL_edgemap_PATH/package/nkmacsec/Config.in"
source "$BR2_EXTERNAL_edgemap_PATH/package/python-argparse/Config.in"
source "$BR2_EXTERNAL_edgemap_PATH/package/python-dateutils/Config.in"
source "$BR2_EXTERNAL_edgemap_PATH/package/python-taky/Config.in"
source "$BR2_EXTERNAL_edgemap_PATH/package/gwsocket/Config.in"
source "$BR2_EXTERNAL_edgemap_PATH/package/highrate/Config.in"
source "$BR2_EXTERNAL_edgemap_PATH/package/curlcot/Config.in"
source "$BR2_EXTERNAL_edgemap_PATH/package/cotsim/Config.in"
source "$BR2_EXTERNAL_edgemap_PATH/package/tacmsgrouter/Config.in"
source "$BR2_EXTERNAL_edgemap_PATH/package/rpiboot/Config.in"
source "$BR2_EXTERNAL_edgemap_PATH/package/audioreceiver/Config.in"
source "$BR2_EXTERNAL_edgemap_PATH/package/audiostreamer/Config.in"
source "$BR2_EXTERNAL_edgemap_PATH/package/modmodem/Config.in"
source "$BR2_EXTERNAL_edgemap_PATH/package/udp2raw/Config.in"
source "$BR2_EXTERNAL_edgemap_PATH/package/rtptun/Config.in"
source "$BR2_EXTERNAL_edgemap_PATH/package/udpspeeder/Config.in"
source "$BR2_EXTERNAL_edgemap_PATH/package/udptunnel/Config.in"
source "$BR2_EXTERNAL_edgemap_PATH/package/coturn/Config.in"
source "$BR2_EXTERNAL_edgemap_PATH/package/gsocket/Config.in"
source "$BR2_EXTERNAL_edgemap_PATH/package/libblinkstick/Config.in"
```

## package/libfido2/Config.in
```kconfig
config BR2_PACKAGE_LIBFIDO2
	bool "libfido2"
    depends on BR2_PACKAGE_HAS_UDEV
	help
	 libfido2 library
```
